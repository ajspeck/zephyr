## boards/arm/xmc47_relax_kit/Kconfig.defconfig
```kconfig
# SPDX-License-Identifier: Apache-2.0
#
# Copyright (c) 2020 Linumiz
# Author: Parthiban Nallathambi <parthiban@linumiz.com>

if BOARD_XMC47_RELAX_KIT

config BOARD
	default "xmc47_relax_kit"

if NETWORKING

config NET_L2_ETHERNET
	default y

config ETH_XMC4XXX
    default y

endif # NETWORKING

endif # BOARD_XMC47_RELAX_KIT
```

## drivers/ethernet/Kconfig.xmc4xxx
```kconfig
# ETH_XMC4XXX Ethernet driver configuration options

# Copyright (c) 2020 SLB
# SPDX-License-Identifier: Apache-2.0

DT_COMPAT_XMC4XXX_ETHERNET := xmc,xmc4xxx_ethernet

menuconfig ETH_XMC4XXX
	bool "Enable XMC4XXX family ethernet driver."
	default y if $(dt_compat_enabled,$(DT_COMPAT_XMC4XXX_ETHERNET))
	help
	  XMC4XXX on-board Ethernet Controller
```

## dts/bindings/ethernet/xmc,xmc4xxx-ethernet.yaml
```yaml
# Copyright (c) 2020 SLB
# SPDX-License-Identifier: Apache-2.0

description: XMC 4XXX Ethernet

compatible: "xmc,xmc4xxx-ethernet"

include: ethernet.yaml

properties:
    reg:
      required: true
    interrupts:
      required: true
```
